## conf/layer.conf
```bitbake
# We have a conf and classes directory, add to BBPATH
BBPATH .= ":${LAYERDIR}"

# We have recipes-* directories, add to BBFILES
BBFILES += "${LAYERDIR}/recipes-*/*/*.bb \
            ${LAYERDIR}/recipes-*/*/*.bbappend"

BBFILE_COLLECTIONS += "meta-simaai"
BBFILE_PATTERN_meta-simaai = "^${LAYERDIR}/"
BBFILE_PRIORITY_meta-simaai = "6"

LAYERDEPENDS_meta-simaai = "core"
LAYERSERIES_COMPAT_meta-simaai = "honister"
```

## conf/machine/davinci.conf
```bitbake
#@TYPE: Machine
#@NAME: SiMa.ai DaVinci common machine file
#@DESCRIPTION: Reference machine configuration for SiMa.ai Davinci based boards

include conf/machine/include/simaai-common.inc

MACHINE ?= "davinci"

#Linux Kernel device trees and configuration for SiMa.ai DaVinci platform
DEVICETREE_NAME = "davinci-combo-board.dtb;boot-0/ davinci-dual-m2.dtb;boot-0/ davinci-hhhl.dtb;boot-0/ \
                   davinci-combo-board.dtb;boot-1/ davinci-dual-m2.dtb;boot-1/ davinci-hhhl.dtb;boot-1/"
KERNEL_DEVICETREE = "simaai/davinci-combo-board.dtb simaai/davinci-dual-m2.dtb \
		     simaai/davinci-hhhl.dtb"
KBUILD_DEFCONFIG ?= "simaai_davinci_defconfig"

#U-BOOT specific config
UBOOT_MACHINE = "sima_davinci-a65_defconfig"

#WIC file ruiles
WKS_FILE ?= "simaai-davinci-image.wks"

# Enable SiMa.ai EULA license
LICENSE_FLAGS_ACCEPTED = "commercial"
SIMAAI_LICENSE_DIR = "${TOPDIR}/../meta-simaai/licenses"
LICENSE_PATH += "${SIMAAI_LICENSE_DIR}"

DISTRO_FEATURES:remove = "alsa pulseaudio bluetooth usbgadget usbhost wifi 3g nfc opengl vulkan x11 wayland"
```

## conf/machine/include/simaai-common.inc
```bitbake
include conf/machine/include/arm/armv8-2a/tune-cortexa65.inc

#TOOLCHAIN specific configs
TUNE_CCARGS += "${@bb.utils.contains("TUNE_FEATURES", "cortexa65", "-mabi=lp64", "", d)}"

#Kernel specific config
MACHINE_ESSENTIAL_EXTRA_RDEPENDS += " kernel-image kernel-devicetree kernel-modules"
CORE_IMAGE_EXTRA_INSTALL += " kernel-image kernel-devicetree kernel-modules"

IMAGE_FSTYPES += "ext4.gz cpio cpio.gz wic.gz wic.bmap"
IMAGE_INSTALL += " kernel-modules kernel-devicetree"

PREFERRED_PROVIDER_virtual/kernel ?= "linux-simaai"
KCONFIG_MODE = "--alldefconfig"

#Use below when we have multiple kernel versions
PREFERRED_VERSION_linux-simaai ?= "6.1%"
KERNEL_IMAGETYPE = "Image"

#U-BOOT specific config
PREFERRED_PROVIDER_virtual/bootloader = "u-boot"
PREFERRED_PROVIDER_u-boot-fw-utils = "libubootenv"

EXTRA_IMAGEDEPENDS += "virtual/bootloader"

IMAGE_BOOT_FILES = "${KERNEL_IMAGETYPE};boot-0/ ${KERNEL_IMAGETYPE};boot-1/ ${DEVICETREE_NAME} uboot.env uboot-redund.env boot.scr.uimg;boot-0/ boot.scr.uimg;boot-1/"
```

## conf/machine/modalix.conf
```bitbake
#@TYPE: Machine
#@NAME: SiMa.ai Modalix common machine file
#@DESCRIPTION: Reference machine configuration for SiMa.ai Modalix based boards

include conf/machine/include/simaai-common.inc

MACHINE ?= "modalix"

# ZEBU flag (default off)
ZEBU ?= "0"
# Init Manager specific config
INIT_MANAGER = "${@'sysvinit' if d.getVar('ZEBU') == '1' else 'systemd'}"

#Linux Kernel device trees and configuration for SiMa.ai Modalix platform
DEVICETREE_NAME = "modalix-dvt.dtb;boot-0/ modalix-hhhl.dtb;boot-0/ \
                   modalix-som.dtb;boot-0/ modalix-som_8g.dtb;boot-0/ \
                   modalix-som_16g.dtb;boot-0/ \
                   modalix-hhhl_x16.dtb;boot-0/ modalix-hhhl_1r.dtb;boot-0/ \
                   modalix-hhhl_v2.dtb;boot-0/ \
                   modalix-dvt.dtb;boot-1/ modalix-hhhl.dtb;boot-1/ \
                   modalix-som.dtb;boot-1/ modalix-som_8g.dtb;boot-1/ \
                   modalix-som_16g.dtb;boot-1/ \
                   modalix-hhhl_x16.dtb;boot-1/ modalix-hhhl_1r.dtb;boot-1/ \
                   modalix-hhhl_v2.dtb;boot-1/"
KERNEL_DEVICETREE = "simaai/modalix-dvt.dtb simaai/modalix-hhhl.dtb simaai/modalix-som.dtb \
                    simaai/modalix-hhhl_x16.dtb simaai/modalix-hhhl_1r.dtb simaai/modalix-hhhl_v2.dtb \
                    simaai/modalix-zebu-basic.dtb simaai/modalix-zebu-pcie.dtb simaai/modalix-som_8g.dtb \
			simaai/modalix-som_16g.dtb"
KBUILD_DEFCONFIG ?= "simaai_modalix_defconfig"

BAUD = "${@115200 if d.getVar('BAUDRATE') == None else d.getVar('BAUDRATE')}"

#Linux console - change default baudrate
SERIAL_CONSOLES ?= "${BAUD};ttyS0"

#U-BOOT specific config
UBOOT_MACHINE = "sima_modalix_defconfig"

#WIC file ruiles
WKS_FILE ?= "simaai-modalix-image.wks"

# Enable SiMa.ai EULA license
LICENSE_FLAGS_ACCEPTED = "commercial"
SIMAAI_LICENSE_DIR = "${TOPDIR}/../meta-simaai/licenses"
LICENSE_PATH += "${SIMAAI_LICENSE_DIR}"

DISTRO_FEATURES:remove = "bluetooth wifi 3g nfc vulkan wayland"
MACHINE_FEATURES += "alsa usbgadget usbhost"
SDKIMAGE_FEATURES:remove ="dbg-pkgs src-pkgs"
```

## wic/simaai-modalix-image.wks
```
# short-description: Create a SiMa.ai Board direct disk image
# long-description: Creates a partitioned legacy disk image that the user
# can directly dd to boot media of SiMa.ai Board.


part --source rawcopy --sourceparams="file=u-boot.bin" --part-name u-boot0 --active --align 1024 --fixed-size 2M
part --source rawcopy --sourceparams="file=u-boot.bin" --part-name u-boot1 --align 1024 --fixed-size 2M
part --source bootimg-sima-partition --part-name boot --include-path=boot-0 --include-path=boot-1  --active --align 1024 --fstype vfat --fixed-size 512M
part --source rootfs --fstype=ext4 --active --part-name platform0 --align 1024 --fixed-size 2G
part --source rootfs --fstype=ext4 --part-name platform1 --align 1024 --fixed-size 2G
part --fstype=ext4 --active --part-name userdata --align 1024 --size 10664943K

bootloader  --ptable gpt --timeout=3
```
